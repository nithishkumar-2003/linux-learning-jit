## Task_OS_Customization/Yocto_Project_RaspPI_28_05_2025/conf/bblayers.conf
```bitbake
# POKY_BBLAYERS_CONF_VERSION is increased each time build/conf/bblayers.conf
# changes incompatibly
POKY_BBLAYERS_CONF_VERSION = "2"

BBPATH = "${TOPDIR}"
BBFILES ?= ""

BBLAYERS ?= " \
  /home/rpi/os_customization/yocto/poky/meta \
  /home/rpi/os_customization/yocto/poky/meta-poky \
  /home/rpi/os_customization/yocto/poky/meta-yocto-bsp \
  /home/rpi/os_customization/yocto/poky/meta-customtesting-layer \
  /home/rpi/os_customization/yocto/poky/meta-raspberrypi \
  /home/rpi/os_customization/yocto/poky/meta-openembedded/meta-oe \
  /home/rpi/os_customization/yocto/poky/meta-openembedded/meta-python \
  /home/rpi/os_customization/yocto/poky/meta-openembedded/meta-networking \
  /home/rpi/os_customization/yocto/poky/meta-openembedded/meta-gnome \
  /home/rpi/os_customization/yocto/poky/meta-openembedded/meta-multimedia \
  /home/rpi/os_customization/yocto/poky/meta-openembedded/meta-xfce \
  /home/rpi/os_customization/yocto/poky/meta-my-layer \
  /home/rpi/os_customization/yocto/poky/meta-caminterface \
  /home/rpi/os_customization/yocto/poky/meta-clang \
  /home/rpi/os_customization/yocto/poky/meta-rust \
  /home/rpi/os_customization/yocto/poky/meta-browser/meta-chromium \
  "
```

## Working_OS_6.1_custom_ADI_Kernel_nanbield/conf/bblayers.conf
```bitbake
# POKY_BBLAYERS_CONF_VERSION is increased each time build/conf/bblayers.conf
# changes incompatibly
POKY_BBLAYERS_CONF_VERSION = "2"

BBPATH = "${TOPDIR}"
BBFILES ?= ""

BBLAYERS ?= " \
  /home/jasminpoc/Analog_OS/custom_os/nanbield/poky/meta \
  /home/jasminpoc/Analog_OS/custom_os/nanbield/poky/meta-poky \
  /home/jasminpoc/Analog_OS/custom_os/nanbield/poky/meta-yocto-bsp \
  /home/jasminpoc/Analog_OS/custom_os/nanbield/poky/meta-raspberrypi \
  /home/jasminpoc/Analog_OS/custom_os/nanbield/poky/meta-openembedded/meta-oe \
  /home/jasminpoc/Analog_OS/custom_os/nanbield/poky/meta-openembedded/meta-python \
  /home/jasminpoc/Analog_OS/custom_os/nanbield/poky/meta-openembedded/meta-networking \
  /home/jasminpoc/Analog_OS/custom_os/nanbield/poky/meta-openembedded/meta-gnome \
  /home/jasminpoc/Analog_OS/custom_os/nanbield/poky/meta-openembedded/meta-perl \
  /home/jasminpoc/Analog_OS/custom_os/nanbield/poky/meta-openembedded/meta-multimedia \
  /home/jasminpoc/Analog_OS/custom_os/nanbield/poky/meta-openembedded/meta-xfce \
  /home/jasminpoc/Analog_OS/custom_os/nanbield/poky/meta-openembedded/meta-filesystems \
  /home/jasminpoc/Analog_OS/custom_os/nanbield/poky/meta-openembedded/meta-initramfs \
  /home/jasminpoc/Analog_OS/custom_os/nanbield/poky/meta-openembedded/meta-webserver \
  /home/jasminpoc/Analog_OS/custom_os/nanbield/poky/meta-qt5 \
  /home/jasminpoc/Analog_OS/custom_os/nanbield/poky/meta-analog \
  /home/jasminpoc/Analog_OS/custom_os/nanbield/poky/meta-custom \
  /home/jasminpoc/Analog_OS/custom_os/nanbield/poky/meta-virtualization \
  /home/jasminpoc/Analog_OS/custom_os/nanbield/poky/meta-iris-thirdparty \
  /home/jasminpoc/Analog_OS/custom_os/nanbield/poky/meta-faceblur \
  "
```
